## Kconfig
```kconfig
menuconfig ZMK_OVERLAY_COMPANION
    bool "ZMK Overlay Companion"
    default n
    depends on ZMK_BLE
    help
      Exposes a small BLE GATT service for companion applications such as
      ZMK Overlay. The service reports the active layer, physical key
      press/release events, resolved modifier state, and protocol capabilities.

      Enable this only on the ZMK device that processes the keymap and
      connects to the host: a normal keyboard, the central half of a split,
      or a dedicated dongle.

      ZMK Studio is required by the desktop application only when manually
      refreshing keymap and physical-layout metadata.

if ZMK_OVERLAY_COMPANION

module = ZMK_OVERLAY_COMPANION
module-str = ZMK Overlay Companion
source "subsys/logging/Kconfig.template.log_config"

endif
```

## config/boards/shields/totem/Kconfig.defconfig
```kconfig
# Copyright (c) 2022 The ZMK Contributors
# SPDX-License-Identifier: MIT

if SHIELD_TOTEM_DONGLE

config ZMK_KEYBOARD_NAME
    default "TOTEM"

config ZMK_SPLIT_ROLE_CENTRAL
    default y

config I2C
    default y

config SSD1306
    default y

choice ZMK_DISPLAY_WORK_QUEUE
    default ZMK_DISPLAY_WORK_QUEUE_DEDICATED
endchoice

endif

if SHIELD_TOTEM_LEFT || SHIELD_TOTEM_RIGHT || SHIELD_TOTEM_DONGLE

config ZMK_SPLIT
    default y

endif

if SHIELD_TOTEM_DONGLE && SSD1306

config LV_Z_VDB_SIZE
    default 64

config LV_DPI_DEF
    default 148

config LV_Z_BITS_PER_PIXEL
    default 1

choice LV_COLOR_DEPTH
    default LV_COLOR_DEPTH_1
endchoice

endif
```

## config/west.yml
```yaml
manifest:
  remotes:
    - name: zmkfirmware
      url-base: https://github.com/zmkfirmware
    - name: englmaxi
      url-base: https://github.com/englmaxi
  projects:
    - name: zmk
      remote: zmkfirmware
      revision: 6e2ef41e022d555b10f116e395832913f71717b3
      import: app/west.yml
    - name: zmk-dongle-display
      remote: englmaxi
      revision: 2bb333f87136d33e94a49d86236ed9ec254a8060
  self:
    path: config
```
